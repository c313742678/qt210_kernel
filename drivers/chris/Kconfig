## drivers/chris/Kconfig
```kconfig
menuconfig CHRIS
	bool "Chris drivers"
	default y
	help
	 the switch of chris drivers

if CHRIS
	source drivers/chris/led/Kconfig
endif
```

## drivers/chris/led/Kconfig
```kconfig
config CHRIS_LEDS
	tristate "Chris_leds"
	default m
	help
	  a simple gpio leds driver
```

## drivers/staging/rtl8192u/Kconfig
```kconfig
config RTL8192U
	tristate "RealTek RTL8192U Wireless LAN NIC driver"
	depends on WLAN && USB
	select WIRELESS_EXT
	select WEXT_PRIV
	default N
	---help---
```
